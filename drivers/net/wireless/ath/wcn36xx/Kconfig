## drivers/net/wireless/ath/wcn36xx/Kconfig
```kconfig
config WCN36XX
	tristate "Qualcomm Atheros WCN3660/3680 support"
	depends on MAC80211 && HAS_DMA
	increment MAC80211_NUM_DRIVERS
	select MAC80211_DRIVER_NO_HWFLAGS_OPT
	---help---
	  This module adds support for wireless adapters based on
	  Qualcomm Atheros WCN3660 and WCN3680 mobile chipsets.

	  If you choose to build a module, it'll be called wcn36xx.

config WCN36XX_DEBUGFS
	bool "WCN36XX debugfs support"
	depends on WCN36XX
	---help---
	  Enabled debugfs support

	  If unsure, say Y to make it easier to debug problems.
```

## drivers/net/wireless/mediatek/mt7601u/Kconfig
```kconfig
config MT7601U
	tristate "MediaTek MT7601U (USB) support"
	depends on MAC80211
	increment MAC80211_NUM_DRIVERS
	select MAC80211_DRIVER_NO_HWFLAGS_OPT
	depends on USB
	---help---
	  This adds support for MT7601U-based wireless USB dongles.
```

## drivers/net/wireless/ti/wl18xx/Kconfig
```kconfig
config WL18XX
	tristate "TI wl18xx support"
	depends on MAC80211
	increment MAC80211_NUM_DRIVERS
	select MAC80211_DRIVER_NO_HWFLAGS_OPT
	select WLCORE
	---help---
	  This module adds support for wireless adapters based on TI
	  WiLink 8 chipsets.
```

## drivers/staging/vt6655/Kconfig
```kconfig
config VT6655
   tristate "VIA Technologies VT6655 support"
   depends on PCI && MAC80211 && m
   increment MAC80211_NUM_DRIVERS
   select MAC80211_DRIVER_NO_HWFLAGS_OPT
   ---help---
   This is a vendor-written driver for VIA VT6655.
```

## drivers/staging/vt6656/Kconfig
```kconfig
config VT6656
	tristate "VIA Technologies VT6656 support"
	depends on MAC80211 && USB && WLAN && m
	increment MAC80211_NUM_DRIVERS
	select MAC80211_DRIVER_NO_HWFLAGS_OPT
	select FW_LOADER
	---help---
	This is a vendor-written driver for VIA VT6656.
```

## net/mac80211/Kconfig.hwflags
```kconfig
config MAC80211_COUNT_DRIVERS
	int
	default 0
config MAC80211_HW_HAS_RATE_CONTROL
	int
	default 0
config MAC80211_HW_RX_INCLUDES_FCS
	int
	default 0
config MAC80211_HW_HOST_BROADCAST_PS_BUFFERING
	int
	default 0
config MAC80211_HW_SIGNAL_UNSPEC
	int
	default 0
config MAC80211_HW_SIGNAL_DBM
	int
	default 0
config MAC80211_HW_NEED_DTIM_BEFORE_ASSOC
	int
	default 0
config MAC80211_HW_SPECTRUM_MGMT
	int
	default 0
config MAC80211_HW_AMPDU_AGGREGATION
	int
	default 0
config MAC80211_HW_SUPPORTS_PS
	int
	default 0
config MAC80211_HW_PS_NULLFUNC_STACK
	int
	default 0
config MAC80211_HW_SUPPORTS_DYNAMIC_PS
	int
	default 0
config MAC80211_HW_MFP_CAPABLE
	int
	default 0
config MAC80211_HW_WANT_MONITOR_VIF
	int
	default 0
config MAC80211_HW_NO_AUTO_VIF
	int
	default 0
config MAC80211_HW_SW_CRYPTO_CONTROL
	int
	default 0
config MAC80211_HW_SUPPORT_FAST_XMIT
	int
	default 0
config MAC80211_HW_REPORTS_TX_ACK_STATUS
	int
	default 0
config MAC80211_HW_CONNECTION_MONITOR
	int
	default 0
config MAC80211_HW_QUEUE_CONTROL
	int
	default 0
config MAC80211_HW_SUPPORTS_PER_STA_GTK
	int
	default 0
config MAC80211_HW_AP_LINK_PS
	int
	default 0
config MAC80211_HW_TX_AMPDU_SETUP_IN_HW
	int
	default 0
config MAC80211_HW_SUPPORTS_RC_TABLE
	int
	default 0
config MAC80211_HW_P2P_DEV_ADDR_FOR_INTF
	int
	default 0
config MAC80211_HW_TIMING_BEACON_ONLY
	int
	default 0
config MAC80211_HW_SUPPORTS_HT_CCK_RATES
	int
	default 0
config MAC80211_HW_CHANCTX_STA_CSA
	int
	default 0
config MAC80211_HW_SUPPORTS_CLONED_SKBS
	int
	default 0
config MAC80211_HW_SINGLE_SCAN_ALL_BANDS
	int
	default 0
config MAC80211_HW_SINGLE_SCAN_ALL_BANDS_OFF
	int
	default 0
config MAC80211_HW_SINGLE_SCAN_ON_ALL_BANDS
	int
	default 0
config MAC80211_HW_TDLS_WIDER_BW
	int
	default 0
config MAC80211_HW_SUPPORTS_AMSDU_IN_AMPDU
	int
	default 0
config MAC80211_HW_BEACON_TX_STATUS
	int
	default 0
```
